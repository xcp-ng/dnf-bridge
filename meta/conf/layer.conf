## meta/conf/layer.conf
```bitbake
# We have a conf and classes directory, add to BBPATH
BBPATH =. "${LAYERDIR}:"
# # We have recipes-* directories, add to BBFILES
# BBFILES += "${LAYERDIR}/recipes-*/*/*.bb"

BBFILE_COLLECTIONS += "dnf-bridge"
BBFILE_PATTERN_dnf-bridge = "^${LAYERDIR}/"
BBFILE_PRIORITY_dnf-bridge = "5"

LAYERSERIES_CORENAMES = "alma10"

# This should only be incremented on significant changes that will
# cause compatibility issues with other layers
LAYERVERSION_dnf-bridge = "1"
LAYERSERIES_COMPAT_dnf-bridge = "alma10"

# Set a variable to get to the top of the metadata location
COREBASE = '${@os.path.normpath("${LAYERDIR}/../")}'

# We need to keep bitbake tools in PATH
# Avoid empty path entries
BITBAKEPATH := "${@os.path.dirname(bb.utils.which(d.getVar('PATH'),'bitbake'))}"
PATH := "${@'${BITBAKEPATH}:' if '${BITBAKEPATH}' != '' else ''}${HOSTTOOLS_DIR}"

# # Only OE-Core should set/change this
# BB_GLOBAL_PYMODULES = "os sys time"

addpylib ${LAYERDIR}/lib oe
```
